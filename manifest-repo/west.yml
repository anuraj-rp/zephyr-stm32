## manifest-repo/west.yml
```yaml
manifest:
  remotes:
    - name: zephyr-kernel
      url-base: https://github.com/zephyrproject-rtos
  projects:
    - name: zephyr-kernel
      remote: zephyr-kernel
      revision: v3.4.0
      import: true
  self:
    path: manifest-repo
```
